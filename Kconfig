## Kconfig
```kconfig
# RT-Thread software package config file for ads128x
menuconfig PKG_USING_ADS128X
    bool "ads128x: TI ADS128x ultra-high-resolution delta-sigma ADC driver"
    default n
    select RT_USING_SPI
    help
        Driver for TI ADS128x family ultra-high-resolution delta-sigma ADC
        (ADS1281 / ADS1282 / ADS1283 / ADS1284), SPI interface.

if PKG_USING_ADS128X

    config ADS128X_USING_ADC_DEVICE
        bool "Register as an RT-Thread ADC device"
        default y
        select RT_USING_ADC
        help
            Wrap the bare driver as an RT-Thread ADC device named "adc_ads128x".

    config ADS128X_USING_ACQDEV
        bool "Register as a standard acquisition device (acqN, unified class)"
        default y
        help
            Register each instance through the shared acquisition-device class
            (acq_device.h/.c) as a plain rt_device ("acq0", "acq1", ...):
            uniform RT_ACQ_CTRL_* commands (rate/start/sync/reset/ownership),
            frame reads and capability info. Aggregators (DeanAcq) and
            applications drive every chip the same way.

    choice
        prompt "chip model"
        default ADS128X_USING_ADS1282

        config ADS128X_USING_ADS1281
            bool "ADS1281 (31-bit, single channel)"

        config ADS128X_USING_ADS1282
            bool "ADS1282 (31-bit)"

        config ADS128X_USING_ADS1283
            bool "ADS1283 (31-bit, low power)"

        config ADS128X_USING_ADS1284
            bool "ADS1284 (31-bit, dual power mode)"
    endchoice

    config ADS128X_MAX_DEVICES
        int "Number of ADS128x devices (multi-chip support)"
        range 1 8
        default 1
        help
            Maximum simultaneous devices driven by one driver instance set.
            Each device needs its own CS (and usually its own DRDY/RESET pins);
            they can share one SPI bus (arbitrated by the SPI framework).

    config ADS128X_USING_ACQ
        bool "Enable the DeanDAQ acquisition module (multi-chip batch publish)"
        default n
        depends on PKG_USING_DDAQ
        help
            A single acquisition thread reads every initialized device from
            its DRDY ISR software ring and publishes batched frames to a
            DeanDAQ topic. Requires the DeanDAQ package (PKG_USING_DDAQ).

    if ADS128X_USING_ACQ

        config ADS128X_ACQ_RING_DEPTH
            int "Per-device ISR ring depth (samples)"
            default 32

        config ADS128X_ACQ_WAIT_TIMEOUT
            int "DRDY gap timeout (ms)"
            default 1000
            help
                How long the acquisition thread tolerates missing DRDY from a
                device before giving up assembling complete frames.

    endif

    config ADS128X_SPI_BUS_NAME
        string "SPI bus name"
        default "spi1"
        help
            The SPI bus that the ADS128x device attached to.

    config ADS128X_SPI_MAX_HZ
        int "SPI clock frequency (Hz)"
        default 10000000
        help
            SPI clock frequency, up to 20MHz per datasheet, 10MHz recommended.

    config ADS128X_CS_PIN
        int "Chip select pin number"
        default -1

    config ADS128X_DRDY_PIN
        int "Data ready (DRDY) pin number"
        default -1

    config ADS128X_RESET_PIN
        int "Reset pin number (hardware reset)"
        default -1

    config ADS128X_DRDY_TIMEOUT
        int "DRDY wait timeout (ms)"
        default 100

    config ADS128X_SAMPLE
        bool "Enable sample command"
        default n
        help
            Enable ads128x_sample msh command.

endif
```
